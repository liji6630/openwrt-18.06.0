## huachentel/linux_arm64.its
```
/*
 * Copyright 2017 NXP
 *
 */


/dts-v1/;

/ {
	description = "arm64 kernel, ramdisk and FDT blob";
	#address-cells = <1>;

	images {
		kernel {
			description = "ARM64 Kernel";
			data = /incbin/("./Image.gz");
			type = "kernel";
			arch = "arm64";
			os = "linux";
			compression = "gzip";
			load = <0x80080000>;
			entry = <0x80080000>;
			hash@1 {
				algo = "crc32";
			};
		};

		initrd {
			description = "initrd for arm64";
			data = /incbin/("./root.ext4.gz");
			type = "ramdisk";
			arch = "arm64";
			os = "linux";
			compression = "none";
			load = <0x00000000>;
			entry = <0x00000000>;
			hash@1 {
				algo = "crc32";
			};
		};	

		hcen104-dtb {
			description = "hcen104-dtb";
			data = /incbin/("./hc-ls1043a-hcen104-sdk.dtb");
			type = "flat_dt";
			arch = "arm64";
			os = "linux";
			compression = "none";
			load = <0x90000000>;
			hash@1 {
				algo = "crc32";
			};
		};

	};

	configurations {		

		hcen104 {
			description = "config for hcen104";
			kernel = "kernel";
			ramdisk = "initrd";
			fdt = "hcen104-dtb";
		};
	};
};
```

## target/linux/layerscape/files/linux_arm64.its
```
/*
 * Copyright 2017 NXP
 *
 */


/dts-v1/;

/ {
	description = "arm64 kernel, ramdisk and FDT blob";
	#address-cells = <1>;

	images {
		kernel {
			description = "ARM64 Kernel";
			data = /incbin/("arch/arm64/boot/Image.gz");
			type = "kernel";
			arch = "arm64";
			os = "linux";
			compression = "gzip";
			load = <0x80080000>;
			entry = <0x80080000>;
			hash@1 {
				algo = "crc32";
			};
		};

		hcen101-dtb {
			description = "hcen101-dtb";
			data = /incbin/("arch/arm64/boot/dts/huachentel/hc-ls1012a-hcen101.dtb");
			type = "flat_dt";
			arch = "arm64";
			os = "linux";
			compression = "none";
			load = <0x90000000>;
			hash@1 {
				algo = "crc32";
			};
		};
		
		hcen104-dtb {
			description = "hcen1004a-dtb";
			data = /incbin/("arch/arm64/boot/dts/huachentel/hc-ls1043a-hcen104-sdk.dtb");
			type = "flat_dt";
			arch = "arm64";
			os = "linux";
			compression = "none";
			load = <0x90000000>;
			hash@1 {
				algo = "crc32";
			};
		};
		hcen104-dpdk {
			description = "hcen1004a-dpdk";
			data = /incbin/("arch/arm64/boot/dts/huachentel/hc-ls1043a-hcen104-usdpaa.dtb");
			type = "flat_dt";
			arch = "arm64";
			os = "linux";
			compression = "none";
			load = <0x90000000>;
			hash@1 {
				algo = "crc32";
			};
		};

		hcen1002a-dtb {
			description = "hcen10042a-dtb";
			data = /incbin/("arch/arm64/boot/dts/huachentel/hc-ls1043a-hcen1002a-sdk.dtb");
			type = "flat_dt";
			arch = "arm64";
			os = "linux";
			compression = "none";
			load = <0x90000000>;
			hash@1 {
				algo = "crc32";
			};
		};
		hcen1002a-dpdk {
			description = "hcen1002a-dpdk";
			data = /incbin/("arch/arm64/boot/dts/huachentel/hc-ls1043a-hcen1002a-usdpaa.dtb");
			type = "flat_dt";
			arch = "arm64";
			os = "linux";
			compression = "none";
			load = <0x90000000>;
			hash@1 {
				algo = "crc32";
			};
		};

		hcen1002b-dtb {
			description = "hcen1002b-dtb";
			data = /incbin/("arch/arm64/boot/dts/huachentel/hc-ls1043a-hcen1002b-sdk.dtb");
			type = "flat_dt";
			arch = "arm64";
			os = "linux";
			compression = "none";
			load = <0x90000000>;
			hash@1 {
				algo = "crc32";
			};
		};
		hcen1002b-dpdk {
			description = "hcen1002b-dpdk";
			data = /incbin/("arch/arm64/boot/dts/huachentel/hc-ls1043a-hcen1002b-usdpaa.dtb");
			type = "flat_dt";
			arch = "arm64";
			os = "linux";
			compression = "none";
			load = <0x90000000>;
			hash@1 {
				algo = "crc32";
			};
		};

		ag10025ga-dtb {
			description = "hcen10042a-dtb";
			data = /incbin/("arch/arm64/boot/dts/huachenlink/hc-ls1043a-ag10025ga-sdk.dtb");
			type = "flat_dt";
			arch = "arm64";
			os = "linux";
			compression = "none";
			load = <0x90000000>;
			hash@1 {
				algo = "crc32";
			};
		};
		ag10025ga-dpdk {
			description = "hcen1002a-dpdk";
			data = /incbin/("arch/arm64/boot/dts/huachenlink/hc-ls1043a-ag10025ga-usdpaa.dtb");
			type = "flat_dt";
			arch = "arm64";
			os = "linux";
			compression = "none";
			load = <0x90000000>;
			hash@1 {
				algo = "crc32";
			};
		};

		ag10025gb-dtb {
			description = "hcen1002b-dtb";
			data = /incbin/("arch/arm64/boot/dts/huachenlink/hc-ls1043a-ag10025gb-sdk.dtb");
			type = "flat_dt";
			arch = "arm64";
			os = "linux";
			compression = "none";
			load = <0x90000000>;
			hash@1 {
				algo = "crc32";
			};
		};
		ag10025gb-dpdk {
			description = "hcen1002b-dpdk";
			data = /incbin/("arch/arm64/boot/dts/huachenlink/hc-ls1043a-ag10025gb-usdpaa.dtb");
			type = "flat_dt";
			arch = "arm64";
			os = "linux";
			compression = "none";
			load = <0x90000000>;
			hash@1 {
				algo = "crc32";
			};
		};
		ag1002at-dtb {
			description = "ag1002at-dtb";
			data = /incbin/("arch/arm64/boot/dts/huachenlink/hc-ls1043a-ag1002at-sdk.dtb");
			type = "flat_dt";
			arch = "arm64";
			os = "linux";
			compression = "none";
			load = <0x90000000>;
			hash@1 {
				algo = "crc32";
			};
		};
		ag1002at-dpdk {
			description = "ag1002at-dpdk";
			data = /incbin/("arch/arm64/boot/dts/huachenlink/hc-ls1043a-ag1002at-usdpaa.dtb");
			type = "flat_dt";
			arch = "arm64";
			os = "linux";
			compression = "none";
			load = <0x90000000>;
			hash@1 {
				algo = "crc32";
			};
		};
		ag1002at-dtb-device {
			description = "ag1002at-dtb";
			data = /incbin/("arch/arm64/boot/dts/huachenlink/hc-ls1043a-ag1002at-sdk-device.dtb");
			type = "flat_dt";
			arch = "arm64";
			os = "linux";
			compression = "none";
			load = <0x90000000>;
			hash@1 {
				algo = "crc32";
			};
		};
		
	};

	configurations {
		
		default = "hcen101";

		hcen101 {
			description = "config for hcen101";
			kernel = "kernel";			 
			fdt = "hcen101-dtb";
		};	
		
		hcen104 {
			description = "config for hcen104";
			kernel = "kernel";			 
			fdt = "hcen104-dtb";
		};	

		hcen104-dpdk {
			description = "config for hcen104";
			kernel = "kernel";			 
			fdt = "hcen104-dpdk";
		};

		hcen1002 {
			description = "config for hcen1002a";
			kernel = "kernel";			 
			fdt = "hcen1002a-dtb";
		};	

		hcen1002-dpdk {
			description = "config for hcen1002a";
			kernel = "kernel";			 
			fdt = "hcen1002a-dpdk";
		};		

		hcen1002b {
			description = "config for hcen1002b";
			kernel = "kernel";			 
			fdt = "hcen1002b-dtb";
		};	

		hcen1002b-dpdk {
			description = "config for hcen1002b";
			kernel = "kernel";			 
			fdt = "hcen1002b-dpdk";
		};
		
		ag10025g {
			description = "config for hcen10025g";
			kernel = "kernel"; 
			fdt = "ag10025ga-dtb";
		};	

		ag10025g-dpdk {
			description = "config for hcen1002a";
			kernel = "kernel";	 
			fdt = "ag10025ga-dpdk";
		};		

		ag10025gb {
			description = "config for hcen10025gb";
			kernel = "kernel";	 
			fdt = "ag10025gb-dtb";
		};	

		ag10025gb-dpdk {
			description = "config for hcen10025gb";
			kernel = "kernel";		 
			fdt = "ag10025gb-dpdk";
		};
		ag1002at {
			description = "config for ag1002at";
			kernel = "kernel";			 
			fdt = "ag1002at-dtb";
		};	
		ag1002atdevice {
			description = "config for ag1002at-device";
			kernel = "kernel"; 
			fdt = "ag1002at-dtb-device";
		};	

		ag1002at-dpdk {
			description = "config for ag1002at dpdk";
			kernel = "kernel";		 
			fdt = "ag1002at-dpdk";
		};
	};
};
```
